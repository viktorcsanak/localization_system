## CMakeLists.txt
```
# SPDX-License-Identifier: Apache-2.0

cmake_minimum_required(VERSION 3.20.0)

find_package(Zephyr REQUIRED HINTS $ENV{ZEPHYR_BASE})
project(Localization_service)

target_sources(app PRIVATE src/main.c)
add_compile_options(-Os)

##################################################################
add_subdirectory(src/dw1000_driver)
target_link_libraries(app PRIVATE dw1000_driver)
target_link_libraries(dw1000_driver INTERFACE zephyr_interface)
target_link_libraries(dw1000_driver PRIVATE kernel)
target_include_directories(dw1000_driver PUBLIC
    ${PROJECT_BINARY_DIR}
    ${ZEPHYR_BASE}/kernel/include
    ${ZEPHYR_BASE}/arch/${ARCH}/include
)

##################################################################
add_subdirectory(src/device_management)
target_link_libraries(app PRIVATE device_management)
target_link_libraries(device_management INTERFACE zephyr_interface)
target_link_libraries(device_management PRIVATE kernel)
target_include_directories(device_management PUBLIC
    ${PROJECT_BINARY_DIR}
    ${ZEPHYR_BASE}/kernel/include
    ${ZEPHYR_BASE}/arch/${ARCH}/include
)

##################################################################
add_subdirectory(src/localization)
target_link_libraries(app PRIVATE localization)
target_link_libraries(localization PRIVATE dw1000_driver)
target_link_libraries(localization INTERFACE zephyr_interface)
target_link_libraries(localization PRIVATE kernel)
target_include_directories(localization PUBLIC
    ${PROJECT_BINARY_DIR}
    ${PROJECT_SOURCE_DIR}/src/dw1000_driver/include
    ${PROJECT_SOURCE_DIR}/src/device_management/include
)

##################################################################

target_include_directories(app PUBLIC
    ${PROJECT_BINARY_DIR}
    ${PROJECT_SOURCE_DIR}/src/dw1000_driver/include
    ${PROJECT_SOURCE_DIR}/src/device_management/include
    ${PROJECT_SOURCE_DIR}/src/localization/include
)
```

## Kconfig
```
source "Kconfig.zephyr"

config LOG_RADIO_HANDLER_LEVEL
    int ""
    default 3
    range 0 4
    
```

## prj.conf
```kconfig
CONFIG_SPI=y
CONFIG_GPIO=y
CONFIG_PRINTK=y

CONFIG_CBPRINTF_FP_SUPPORT=y

CONFIG_NVS=y
CONFIG_FLASH=y
CONFIG_FLASH_PAGE_LAYOUT=y

CONFIG_HWINFO=y

CONFIG_LOG=y
CONFIG_LOG_MODE_MINIMAL=y
CONFIG_LOG_DEFAULT_LEVEL=3

CONFIG_HEAP_MEM_POOL_SIZE=4096

CONFIG_BT=y
CONFIG_BT_SMP=y
CONFIG_BT_PERIPHERAL=y

CONFIG_BT_DEVICE_NAME="DWMANCHOR"
CONFIG_BT_DEVICE_APPEARANCE=128

CONFIG_HW_STACK_PROTECTION=y

CONFIG_HARDWARE_DEVICE_CS_GENERATOR=y

CONFIG_LOG_RADIO_HANDLER_LEVEL=3

CONFIG_DSP=y
CONFIG_CMSIS_DSP=y
CONFIG_CMSIS_DSP_MATRIX=y
CONFIG_DSP_BACKEND_CMSIS=y

#CONFIG_BT_DIS is not set
#CONFIG_BT_DIS_MODEL is not set
#CONFIG_BT_DIS_MANUF is not set
#CONFIG_BT_DIS_PNP is not set
```

## src/main.c
```c
#include <deca_device_api.h>
#include <deca_regs.h>
#include <deca_spi.h>
#include <deca_types.h>
#include <port.h>

#include <device_management.h>
#include <gatt_service.h>
#include <device_config.h>

#include <radio_handler.h>

#include <zephyr/sys/printk.h>
#include <zephyr/kernel.h>

#include <zephyr/logging/log.h>
LOG_MODULE_REGISTER(main, CONFIG_LOG_DEFAULT_LEVEL);

extern int dw_twr_resp_main(void);
extern int dw_twr_init_main(void);

int main(void)
{
    int rc = dev_mgmt_config_init();
    if (rc) {
        LOG_ERR("%s: failed to load configuration %d", __func__, rc);
        return rc;
    }

    rc = dev_mgmt_init();
    if (rc) {
        LOG_ERR("%s: failed to initialize device management %d", __func__, rc);
        return rc;
    }

    rc = dev_mgmt_gatt_service_init();

    rc = radio_handler_init();
    if (rc) {
        LOG_ERR("%s: failed to initialize radio handler %d", __func__, rc);
        return rc;
    }

    //dw_twr_init_main();
    //dw_twr_resp_main();

    uint8_t rtls_role = dev_mgmt_get_config()->rtls_role;
    uint32_t device_id = dev_mgmt_get_config()->device_id;
    LOG_INF("Device %08x booting as %d", device_id, rtls_role);

    if (rtls_role != TAG) {
        return 0;
    }

    while (1) {
        rc = start_measurement();
        if (rc) {
            LOG_ERR("%s: failed to start measurement %d", __func__, rc);
        }
        k_sleep(K_MSEC(1000));
    }

    return -1;
}
```
